## build/conf/bblayers.conf
```bitbake
# POKY_BBLAYERS_CONF_VERSION is increased each time build/conf/bblayers.conf
# changes incompatibly
POKY_BBLAYERS_CONF_VERSION = "2"

BBPATH = "${TOPDIR}"
BBFILES ?= ""

BBLAYERS ?= " \
  /mnt/windows/yocto-ota-swupdate-qemu/poky/meta \
  /mnt/windows/yocto-ota-swupdate-qemu/poky/meta-poky \
  /mnt/windows/yocto-ota-swupdate-qemu/poky/meta-yocto-bsp \
  /mnt/windows/yocto-ota-swupdate-qemu/meta-openembedded/meta-oe \
  /mnt/windows/yocto-ota-swupdate-qemu/meta-swupdate \
  /mnt/windows/yocto-ota-swupdate-qemu/meta-moez \
  "
```

## secureboot/fit/kernel.its
```
/dts-v1/;

/ {
    description = "Signed FIT image for qemuarm Secure Boot";
    #address-cells = <1>;

    images {
        kernel-1 {
            description = "Linux kernel signed";
            data = /incbin/("./zImage");
            type = "kernel";
            arch = "arm";
            os = "linux";
            compression = "none";
            load = <0x40400000>;
            entry = <0x40400000>;
            hash-1 {
                algo = "sha256";
            };
        };
    };

    configurations {
        default = "conf-1";
        conf-1 {
            description = "Boot signed kernel";
            kernel = "kernel-1";
            signature-1 {
                algo = "sha256,rsa2048";
                key-name-hint = "fit-private";
                sign-images = "kernel";
            };
        };
    };
};
```
