/dts-v1/;

/ {

	signature {

		key-fit-private {
			required = "conf";
			algo = "sha256,rsa2048";
			rsa,r-squared = <0x67971e36 0x873f58ac 0xa068a9e5 0xf4b40ab6 0xbb30b6ea 0x5e964f8 0x464dd097 0x2d620eba 0x632a6806 0x38b0b883 0xe39233e8 0xc1f3048b 0xc6f2f6a 0xa4f1f94c 0x59bc550a 0xfcaf0c68 0x80f8e5fd 0x21cf4f9a 0xaf6989a8 0xbae7a321 0x5aeb34b1 0x47edf4ab 0x515c7fbf 0x8ed42104 0xb33dcc1d 0x7109d56 0x88f89332 0xa05526ea 0xf08f8240 0xdd07f596 0x8e48929e 0xc0be9720 0x645dd92b 0x80a64f9d 0xad1db7ac 0x338e0f56 0x25849417 0x8e72e4de 0xbdc1ecf5 0x149b1f21 0xeb150962 0xbee1c9cd 0x456f2064 0x908a7816 0xa14dbbd5 0xd48a317f 0x540891c4 0xdca3b7a 0x9e846f13 0xa9b87e26 0x9fdff64b 0xd2d1d51d 0x90450310 0xa6b8a9d 0x7eb93c22 0xdde5a6e8 0xb4e3e95e 0xdf3a0f93 0xf8a6a95d 0x2556e935 0x310086d3 0x6eb206f2 0x2729e566 0x9f65c927>;
			rsa,modulus = <0x90fdbcbf 0xc3d00130 0x119e4b9 0x6cdfbf21 0x118ce37f 0xd167f03a 0x8a53640d 0x9412ba14 0x9cc25939 0x505b20af 0x5cbd52c4 0x4227dd3d 0x6b85ab46 0x5eb70644 0x695456aa 0x8c4357a3 0x8ed3d9f7 0xf5879e35 0x88b9c1b2 0x42443a73 0x9091740a 0x367f9f5d 0x89c18da8 0x854697ac 0x78f7fb81 0x8f5f3321 0x20838faf 0x386ca68a 0x256e5987 0xb8394743 0x474298bb 0xc520d469 0x6c8d605a 0xab9934d 0x6ffaca49 0xcdf11e0d 0x1212358f 0xac501eae 0xc64fb488 0xf68bfec2 0x1082929a 0xf1c47343 0x93987866 0x3bfa65ba 0xc980c5a6 0x74a9f1a0 0x5f5d50e0 0xc840d53b 0x82ccc1fe 0xaef6e202 0x74146740 0x62702cf9 0xb742ef18 0x55725073 0xb61d5094 0x8e5364c6 0xb22919e6 0xc0598551 0xc33b9d57 0x8ce9276e 0xe1102be6 0xccc987ac 0x482c0b8a 0x3a5eba11>;
			rsa,exponent = <0x00 0x10001>;
			rsa,n0-inverse = <0xd4e0890f>;
			rsa,num-bits = <0x800>;
			key-name-hint = "fit-private";
		};
	};
};
